/*
 * Copyright (c) 2022 Baumer (www.baumer.com)
 *
 * SPDX-License-Identifier: Apache-2.0
 */

&sim_flash {
	erase-value = < 0x00 >;
};

&eeprom1 {
	partitions {
		#address-cells = <1>;
		#size-cells = <1>;
		eeprom_nvs_partition: partition@0 {
			reg = <0x00000000 0x00000A00>;
		};
	};
};
