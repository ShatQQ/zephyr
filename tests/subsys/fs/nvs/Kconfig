## tests/subsys/fs/nvs/Kconfig
```kconfig
# Copyright (c) 2022 Baumer (www.baumer.com)
#
# SPDX-License-Identifier: Apache-2.0

mainmenu "NVS eeprom test switch"

source "Kconfig.zephyr"

config NVS_TEST_EEPROM
	bool "Select to test additional custom filesystem configurations"
	help Due to eeprom emulation the zephyr internal CONFIG_EEPROM / CONFIG_FLASH switch
	can not be used therfore this switch is used for testing.
```

## tests/subsys/fs/nvs/testcase.yaml
```yaml
common:
  tags: nvs
tests:
  filesystem.nvs.flash:
    platform_allow: qemu_x86
  filesystem.nvs.eeprom:
    extra_args: CONF_FILE="prj_nvs_eeprom.conf"
    platform_allow: qemu_x86
  filesystem.nvs_0x00.flash:
    extra_args: DTC_OVERLAY_FILE=boards/qemu_x86_ev_0x00.overlay
    platform_allow: qemu_x86
  filesystem.nvs_cache.flash:
    extra_args: CONFIG_NVS_LOOKUP_CACHE=y
                CONFIG_NVS_LOOKUP_CACHE_SIZE=64
    platform_allow: native_posix
```
